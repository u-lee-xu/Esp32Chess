## esp32_chess_ai/sdkconfig.defaults
```kconfig
# ESP32-P4 Configuration
CONFIG_IDF_TARGET="esp32p4"

# CPU Frequency
CONFIG_ESP_DEFAULT_CPU_FREQ_MHZ=400

# Memory Configuration
CONFIG_ESP32P4_SPIRAM=y
CONFIG_SPIRAM=y
CONFIG_SPIRAM_SPEED_80M=y
CONFIG_SPIRAM_USE_MALLOC=y

# FreeRTOS Configuration
CONFIG_FREERTOS_HZ=1000

# Watchdog Configuration
CONFIG_ESP_TASK_WDT=n
CONFIG_ESP_TASK_WDT_INIT=n

# Log Configuration
CONFIG_LOG_DEFAULT_LEVEL_INFO=y

# USB-Serial/JTAG Configuration
CONFIG_ESP_USB_OTG=y
CONFIG_USB_OTG_SUPPORTED=y
CONFIG_ESP_CONSOLE_USB_SERIAL_JTAG=y
CONFIG_ESP_CONSOLE_USB_SERIAL_JTAG_ENABLED=y
```

## test_input/sdkconfig.defaults
```kconfig
CONFIG_IDF_TARGET="esp32p4"
CONFIG_ESPTOOLPY_FLASHSIZE_16MB=y
CONFIG_ESP_CONSOLE_USB_SERIAL_JTAG=y
# CONFIG_ESP_CONSOLE_SECONDARY_USB_SERIAL_JTAG is not set
```
